## meta-custom-image-homeassistant/conf/layer.conf
```bitbake
# We have a conf and classes directory, add to BBPATH
BBPATH .= ":${LAYERDIR}"

# We have recipes-* directories, add to BBFILES
BBFILES += "${LAYERDIR}/recipes-*/*/*.bb \
            ${LAYERDIR}/recipes-*/*/*.bbappend"

BBFILE_COLLECTIONS += "meta-custom-image-homeassistant"
BBFILE_PATTERN_meta-custom-image-homeassistant = "^${LAYERDIR}/"
BBFILE_PRIORITY_meta-custom-image-homeassistant = "6"

LAYERVERSION_meta-custom-image-homeassistant = "1"
LAYERDEPENDS_meta-custom-image-homeassistant = "core"
LAYERSERIES_COMPAT_meta-custom-image-homeassistant = "kirkstone" 
```
